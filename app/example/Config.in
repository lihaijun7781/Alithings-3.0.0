## app/example/Config.in
```kconfig
# --- Generated Automatically ---
config AOS_APP_EXAMPLE
    bool "Builtin Examples"

if AOS_APP_EXAMPLE
choice
    prompt "Select example"

source "app/example/dk/dk_gui/Config.in"
if AOS_APP_DK_GUI
    config AOS_BUILD_APP
        default "dk.dk_gui"
endif

source "app/example/udata_demo/sensor_cloud_demo/Config.in"
if AOS_APP_SENSOR_CLOUD_DEMO
    config AOS_BUILD_APP
        default "udata_demo.sensor_cloud_demo"
endif

source "app/example/udata_demo/udata_local_demo/Config.in"
if AOS_APP_UDATA_LOCAL_DEMO
    config AOS_BUILD_APP
        default "udata_demo.udata_local_demo"
endif

source "app/example/udata_demo/udata_cloud_demo/Config.in"
if AOS_APP_UDATA_CLOUD_DEMO
    config AOS_BUILD_APP
        default "udata_demo.udata_cloud_demo"
endif

source "app/example/udata_demo/sensor_local_demo/Config.in"
if AOS_APP_SENSOR_LOCAL_DEMO
    config AOS_BUILD_APP
        default "udata_demo.sensor_local_demo"
endif

source "app/example/blink/Config.in"
if AOS_APP_BLINK
    config AOS_BUILD_APP
        default "blink"
endif

source "app/example/mqttapp/Config.in"
if AOS_APP_MQTTAPP
    config AOS_BUILD_APP
        default "mqttapp"
endif

source "app/example/helloworld/Config.in"
if AOS_APP_HELLOWORLD
    config AOS_BUILD_APP
        default "helloworld"
endif
source "app/example/raceled/Config.in"
if AOS_APP_RACELED
    config AOS_BUILD_APP
        default "raceled"
endif

source "app/example/sensor_gui/Config.in"
if AOS_APP_SENSOR_GUI
    config AOS_BUILD_APP
        default "sensor_gui"
endif

endchoice
endif
# --- End ---
```

## board/Config.in
```kconfig
# --- Generated Automatically ---
menu "BSP         Configuration"
choice
    prompt "Select board"

source "board/stm32l476rg-nucleo/Config.in"
if AOS_BOARD_STM32L476RG_NUCLEO
    config AOS_BUILD_BOARD
        default "stm32l476rg-nucleo"

    source "platform/mcu/stm32l4xx_cube/Config.in"
    source "platform/arch/arm/armv7m/Config.in"
endif

source "board/everylinked/Config.in"
if AOS_BOARD_EVERYLINKED
    config AOS_BUILD_BOARD
        default "everylinked"

    source "platform/mcu/stm32l4xx_cube/Config.in"
    source "platform/arch/arm/armv7m/Config.in"
endif

endchoice

endmenu
# --- End ---
```

## kernel/Config.in
```kconfig
source "kernel/rhino/Config.in"
source "kernel/init/Config.in"
source "kernel/cli/Config.in"
source "kernel/debug/Config.in"
source "kernel/fs/kv/Config.in"
source "kernel/fs/vfs/Config.in"
source "kernel/bus/mbmaster/Config.in"
```

## utility/app/example/raceled/Config.in
```kconfig
config AOS_APP_RACELED
    bool "Race Led Sample"
    select AOS_COMP_OSAL_AOS
    help
        raceled sample

if AOS_APP_RACELED
# Configurations for app raceled
endif
```

## utility/app/example/sensor_gui/Config.in
```kconfig
config AOS_APP_SENSOR_GUI
    bool "Everylinked sensor GUI Sample"
    select AOS_COMP_LITTLEVGL
    select AOS_COMP_CLI
    select AOS_COMP_YLOOP
    select AOS_COMP_NETMGR
    select AOS_COMP_SENSOR
    select AOS_COMP_CJSON
    select AOS_COMP_SDK_DEVMODEL
    help
        EveryLinked Sensor GUI example

if AOS_APP_SENSOR_GUI
# Configurations for app Sensor_gui
endif
```

## utility/network/Config.in
```kconfig
menu "Network     Configuration"

source "network/nal/sal/Config.in"
source "network/netmgr/Config.in"
source "network/yloop/Config.in"
source "network/und/Config.in"

endmenu
```

## utility/security/Config.in
```kconfig
menu "Security    Configuration"

## --- Generated Automatically ---
source "security/ls_osa/Config.in"
source "security/ls_hal/Config.in"
source "security/alicrypto/Config.in"
source "security/id2/Config.in"
source "security/irot/Config.in"
source "security/irot/km/Config.in"
source "security/irot/se/Config.in"
source "security/irot/tee/Config.in"
source "security/itls/Config.in"
## --- End ---

endmenu
```
